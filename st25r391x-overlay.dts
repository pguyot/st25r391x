/dts-v1/;
/plugin/;

/ {
    compatible = "brcm,bcm2708";

    fragment@0 {
        target = <&i2c1>;
        __overlay__ {
            #address-cells = <1>;
            #size-cells = <0>;
            status = "okay";

            st25r391x: st25r391x{
                compatible = "stm,st25r391x";
                reg = <0x50>;
            };
        };
    };
};
